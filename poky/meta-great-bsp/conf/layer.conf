## poky/meta-great-bsp/conf/layer.conf
```bitbake
BBPATH  =. "${LAYERDIR}:"
BBFILES += "${LAYERDIR}/recipes*/*/*.bb"
BBFILES += "${LAYERDIR}/recipes*/*/*.bbappend"
BBFILES += "${LAYERDIR}/append/*.bbappend"
BBFILES += "${LAYERDIR}/recipes*/*.bb"
BBFILE_COLLECTIONS += "greatbsp"
BBFILE_PATTERN_greatbsp = "^${LAYERDIR}/"
BBFILE_PRIORITY_greatbsp = "6"
LAYERSERIES_COMPAT_greatbsp = "${LAYERSERIES_COMPAT_core}"
```

## poky/meta-great/conf/distro/great-distro.conf
```bitbake
DISTRO = "great-distro"
DISTRO_NAME = "Great distro"
DISTRO_VERSION = "3.1.21"
DISTRO_CODENAME = "dunfell"
SDK_VENDOR = "-greatsdk"
SDK_VERSION = "${@d.getVar('DISTRO_VERSION').replace('snapshot-${DATE}', 'snapshot')}"

MAINTAINER = "Great <great@great.org>"

TARGET_VENDOR = "-great"

LOCALCONF_VERSION = "1"

DISTRO_VERSION[vardepsexclude] = "DATE"
SDK_VERSION[vardepsexclude] = "DATE"

# Override these in poky based distros
GREAT_DEFAULT_DISTRO_FEATURES = "largefile opengl ptest multiarch wayland vulkan"
GREAT_DEFAULT_EXTRA_RDEPENDS = "packagegroup-core-boot"
GREAT_DEFAULT_EXTRA_RRECOMMENDS = "kernel-module-af-packet"

DISTRO_FEATURES ?= "${DISTRO_FEATURES_DEFAULT} ${GREAT_DEFAULT_DISTRO_FEATURES}"

PREFERRED_VERSION_linux-yocto ?= "5.4%"

SDK_NAME = "${DISTRO}-${TCLIBC}-${SDKMACHINE}-${IMAGE_BASENAME}-${TUNE_PKGARCH}-${MACHINE}"
SDKPATHINSTALL = "/opt/${DISTRO}/${SDK_VERSION}"

DISTRO_EXTRA_RDEPENDS += " ${GREAT_DEFAULT_EXTRA_RDEPENDS}"
DISTRO_EXTRA_RRECOMMENDS += " ${GREAT_DEFAULT_EXTRA_RRECOMMENDS}"

GREATQEMUDEPS = "${@bb.utils.contains("INCOMPATIBLE_LICENSE", "GPL-3.0", "", "packagegroup-core-device-devel",d)}"
DISTRO_EXTRA_RDEPENDS_append_great = " ${GREATQEMUDEPS}"

TCLIBCAPPEND = ""

# QA check settings - a little stricter than the OE-Core defaults
WARN_TO_ERROR_QA = "already-stripped compile-host-path install-host-path \
                    installed-vs-shipped ldflags pn-overrides rpaths staticdev \
                    unknown-configure-option useless-rpaths"
WARN_QA_remove = "${WARN_TO_ERROR_QA}"
ERROR_QA_append = " ${WARN_TO_ERROR_QA}"

require conf/distro/include/no-static-libs.inc
require conf/distro/include/yocto-uninative.inc
require conf/distro/include/security_flags.inc
INHERIT += "uninative"

INHERIT += "reproducible_build"

BB_SIGNATURE_HANDLER ?= "OEEquivHash"
BB_HASHSERVE ??= "auto"
```

## poky/meta-great/conf/layer.conf
```bitbake
BBPATH  =. "${LAYERDIR}:"
BBFILES += "${LAYERDIR}/recipes*/*/*.bb"
BBFILES += "${LAYERDIR}/recipes*/*/*.bbappend"
BBFILE_COLLECTIONS += "great"
BBFILE_PATTERN_great = "^${LAYERDIR}/"
BBFILE_PRIORITY_great = "11"
LAYERDEPENDS_great = "core"
LAYERSERIES_COMPAT_great = "${LAYERSERIES_COMPAT_core}"
```

## poky/meta-hello/conf/layer.conf
```bitbake
BBPATH                    =. "${LAYERDIR}:"
BBFILES                   += "${LAYERDIR}/recipes*/*.bb \
                              ${LAYERDIR}/recipes*/*/*.bbappend \
                             "
BBFILE_COLLECTIONS        += "hello"
BBFILE_PATTERN_hello      = "^${LAYERDIR}/"
BBFILE_PRIORITY_hello     = "10"
LAYERSERIES_COMPAT_hello  = "${LAYERSERIES_COMPAT_core}"
```

## poky/meta-myproject/conf/layer.conf
```bitbake
BBPATH  =. "${LAYERDIR}:"
BBFILES += "${LAYERDIR}/recipes*/*.bb \
            ${LAYERDIR}/recipes*/*/*.bb \
            ${LAYERDIR}/recipes*/*/*.bbappend \
            ${LAYERDIR}/appends*/*.bbappend \
            "

BBFILE_COLLECTIONS += "myproject"
BBFILE_PATTERN_myproject = "^${LAYERDIR}/"
BBFILE_PRIORITY_myproject = "12"
LAYERSERIES_COMPAT_myproject = "${LAYERSERIES_COMPAT_core}"
```

## poky/meta-nano-editor/conf/layer.conf
```bitbake
BBPATH  =. "${LAYERDIR}:"
BBFILES += "${LAYERDIR}/recipes*/*.bb"
BBFILE_COLLECTIONS += "nano-editor"
BBFILES += "${LAYERDIR}/recipes*/*/*.bbappend"
BBFILE_PATTERN_nano-editor = "^${LAYERDIR}/"
BBFILE_PRIORITY_nano-editor = "10"
LAYERSERIES_COMPAT_nano-editor = "${LAYERSERIES_COMPAT_core}"
```
